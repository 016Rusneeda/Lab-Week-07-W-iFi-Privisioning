## Lab7-1-Reset-and-NVS-Forensics/main/Kconfig.projbuild
```kconfig
menu "Example Configuration"
    config EXAMPLE_RESET_PROVISIONED
        bool "Reset Provisioned state (Erase credentials)"
        default n
        help
            If checked, the device will erase NVS and reset provisioned state on boot.
endmenu
```
